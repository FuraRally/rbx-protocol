## Kconfig
```kconfig
menu "Rabbit protocol (rbx)"

    config RBX_MAX_BOX_CLIENTS
        int "Max box clients per transport"
        range 1 8
        default 4
        help
            Simultaneous Rabbit 2 / Rabbit Connect clients the box server accepts (TCP), and UDP
            clients it remembers.

    config RBX_MAX_PILOTS
        int "Max pilot screens (pilot server)"
        range 1 8
        default 4

    config RBX_TASK_STACK
        int "Task stack size"
        default 4096

    config RBX_TASK_PRIORITY
        int "Task priority"
        range 1 24
        default 5

endmenu
```

## examples/box_with_pilot/main/Kconfig.projbuild
```kconfig
menu "Example configuration"

    config EXAMPLE_AP_SSID
        string "Access point SSID"
        default "RabbitBox1001"
        help
            Rabbit 2 learns the box number from an SSID "RabbitBox<n>". Use 1000-1099 (not 1051) for TCP.

    config EXAMPLE_AP_PASSWORD
        string "Access point password (empty = open)"
        default ""

    config EXAMPLE_SIM_SPEED_KMH
        int "Simulated speed (km/h)"
        default 50

endmenu
```
